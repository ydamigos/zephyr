## boards/arm/96b_carbon/Kconfig.defconfig
```kconfig
# Kconfig - 96boards Carbon board configuration
#
# Copyright (c) 2016 Linaro Limited.
#
# SPDX-License-Identifier: Apache-2.0
#

if BOARD_96B_CARBON

config BOARD
	default 96b_carbon

if BT

config SPI
	default y

config SPI_STM32
	default y

config SPI_STM32_INTERRUPT
	default y

config SPI_1
	default y

config SPI_1_IRQ_PRI
	default 5

config SPI_LEGACY_API
	default n

endif # BT

if NETWORKING

# BT is the only onboard network iface, so use it for IP networking
# if it's enabled

config NET_L2_BT
	default y

config NET_L2_BT_ZEP1656
	default y

endif # NETWORKING

if USB

if USB_CDC_ACM

config CDC_ACM_INT_EP_ADDR
	default 0x81

config CDC_ACM_IN_EP_ADDR
	default 0x83

endif # USB_CDC_ACM

endif # USB

endif # BOARD_96B_CARBON
```

## dts/bindings/usb/usb-ep.yaml
```yaml
---
title: USB Endpoints' properties
id: USB-EP
version: 0.1

description: >
    This binding gives number of endpoints that the USB hardware supports

properties:
  - num-bidir-endpoints:
      type: int
      category: required
      description: Number of bi-directional endpoints supported by hardware
                   (including EP0)
      generation: define

  - num-in-endpoints:
      type: int
      category: optional
      description: Number of IN endpoints supported by hardware
                   (including EP0 IN)
      generation: define

  - num-out-endpoints:
      type: int
      category: optional
      description: Number of OUT endpoints supported by hardware
                   (including EP0 OUT)
      generation: define
...
```

## dts/bindings/usb/usb.yaml
```yaml
---
title: USB Base Structure
id: USB
version: 0.1

description: >
    This binding gives the base structures for all USB devices

properties:
  - compatible:
      type: string
      category: required
      description: compatible strings

  - clock-frequency :
      type: int
      category: optional
      description: Initial clock frequency in Hz
      generation: define

  - clocks:
      type: array
      category: required
      description: Clock gate information
      generation: define

  - label:
      type: string
      category: required
      description: Human readable string describing the device (used by Zephyr for API name)
      generation: define
...
```
